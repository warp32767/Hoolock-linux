// SPDX-License-Identifier: GPL-2.0-only
/dts-v1/;

#include "t8030.dtsi"

/ {
	compatible = "apple,d79", "apple,t8030", "apple,arm-platform";
	model = "Apple iPhone SE (2nd generation)";

	chosen {
		#address-cells = <2>;
		#size-cells = <2>;
		ranges;
		stdout-path = "serial0:115200n8";

		framebuffer@0 {
			compatible = "apple,simple-framebuffer", "simple-framebuffer";
			reg = <0 0 0 0>; /* To be filled by loader */

			/* Format properties will be added by loader */
			status = "disabled";
		};
	};
};
